// GENERATED by scripts/gen_amy_c_api.py -- do not edit; edit the table there
{"send_wire", amy_capi_py_send_wire, METH_VARARGS, "Send a wire-protocol message to AMY"},
{"send_wire_from_sysex", amy_capi_py_send_wire_from_sysex, METH_VARARGS, "Send a wire message as if from sysex (file-transfer routing applies)"},
{"ticks_ms", amy_capi_py_ticks_ms, METH_VARARGS, "Read the AMY millisecond clock"},
{"reset_sysclock", amy_capi_py_reset_sysclock, METH_VARARGS, "Reset the AMY millisecond clock to zero"},
{"render_load", amy_capi_py_render_load, METH_VARARGS, "Smoothed fraction of real time AMY spends rendering (0..1)"},
{"set_render_load_threshold", amy_capi_py_set_render_load_threshold, METH_VARARGS, "Set the render-load fraction that trips the overload failsafe (0 disables)"},
{"bleep", amy_capi_py_bleep, METH_VARARGS, "Play the startup bleep"},
{"sequencer_ticks", amy_capi_py_sequencer_ticks, METH_VARARGS, "Read the sequencer tick count"},
{"process_single_midi_byte", amy_capi_py_process_single_midi_byte, METH_VARARGS, "Feed one MIDI byte to AMY's stream parser"},
{"set_cv_from_osc", amy_capi_py_set_cv_from_osc, METH_VARARGS, "Feed external CV input from a mod osc (testing support)"},
{"get_synth_commands", amy_capi_py_get_synth_commands, METH_VARARGS, "Read the wire commands that reconstruct synth state (list of str)"},
{"dump_state", amy_capi_py_dump_state, METH_VARARGS, "Read the complete replayable AMY state as a wire-command string"},
{"get_output_buffer", amy_capi_py_get_output_buffer, METH_VARARGS, "Read the most recent rendered audio block as bytes (None if none ready)"},
{"get_input_buffer", amy_capi_py_get_input_buffer, METH_VARARGS, "Read the most recent captured input audio block as bytes (None if none ready)"},
