// GENERATED by scripts/gen_amy_c_api.py -- do not edit; edit the table there
static PyObject * amy_capi_py_send_wire(PyObject *self, PyObject *args) {
    (void)self;
    char *message = NULL;
    if (!PyArg_ParseTuple(args, "s", &message)) return NULL;
    amy_add_message(message);
    Py_RETURN_NONE;
}

static PyObject * amy_capi_py_send_wire_from_sysex(PyObject *self, PyObject *args) {
    (void)self;
    char *message = NULL;
    if (!PyArg_ParseTuple(args, "s", &message)) return NULL;
    amy_add_message_from_sysex(message);
    Py_RETURN_NONE;
}

static PyObject * amy_capi_py_ticks_ms(PyObject *self, PyObject *args) {
    (void)self;
    (void)args;
    return Py_BuildValue("I", (unsigned int)amy_sysclock());
}

static PyObject * amy_capi_py_reset_sysclock(PyObject *self, PyObject *args) {
    (void)self;
    (void)args;
    amy_reset_sysclock();
    Py_RETURN_NONE;
}

static PyObject * amy_capi_py_render_load(PyObject *self, PyObject *args) {
    (void)self;
    (void)args;
    return Py_BuildValue("f", amy_get_render_load());
}

static PyObject * amy_capi_py_set_render_load_threshold(PyObject *self, PyObject *args) {
    (void)self;
    float threshold = 0;
    if (!PyArg_ParseTuple(args, "f", &threshold)) return NULL;
    amy_set_render_load_threshold(threshold);
    Py_RETURN_NONE;
}

static PyObject * amy_capi_py_bleep(PyObject *self, PyObject *args) {
    (void)self;
    int start = 0;
    if (!PyArg_ParseTuple(args, "|i", &start)) return NULL;
    amy_bleep((uint32_t)start);
    Py_RETURN_NONE;
}

static PyObject * amy_capi_py_sequencer_ticks(PyObject *self, PyObject *args) {
    (void)self;
    (void)args;
    return Py_BuildValue("I", (unsigned int)sequencer_ticks());
}

static PyObject * amy_capi_py_process_single_midi_byte(PyObject *self, PyObject *args) {
    (void)self;
    int byte = 0;
    int from_web_or_usb = 1;
    if (!PyArg_ParseTuple(args, "i|i", &byte, &from_web_or_usb)) return NULL;
    amy_process_single_midi_byte((uint8_t)byte, (uint8_t)from_web_or_usb);
    Py_RETURN_NONE;
}

static PyObject * amy_capi_py_set_cv_from_osc(PyObject *self, PyObject *args) {
    (void)self;
    int cv_channel = 0;
    int osc = 0;
    if (!PyArg_ParseTuple(args, "ii", &cv_channel, &osc)) return NULL;
    set_cv_from_osc((int32_t)cv_channel, (int32_t)osc);
    Py_RETURN_NONE;
}

static PyObject * amy_capi_py_get_synth_commands(PyObject *self, PyObject *args) {
    (void)self;
    char s[MAX_MESSAGE_LEN];
    void *state = NULL;
    int synth = 0;
    int include_fx = 1;
    if (!PyArg_ParseTuple(args, "i|p", &synth, &include_fx)) return NULL;
    PyObject *list_obj = PyList_New(0);
    if (list_obj == NULL) return NULL;
    do {
        state = yield_synth_commands((uint8_t)synth, s, MAX_MESSAGE_LEN, (bool)include_fx, state);
        if (strlen(s))
            PyList_Append(list_obj, PyUnicode_FromString(s));
    } while (state != NULL);
    return list_obj;
}

static PyObject * amy_capi_py_dump_state(PyObject *self, PyObject *args) {
    (void)self;
    (void)args;
    int len = 0;
    char *dump = amy_dump_state_to_string(&len);
    if (dump == NULL) return PyErr_NoMemory();
    PyObject *result = PyUnicode_FromStringAndSize(dump, len);
    free(dump);
    return result;
}

static PyObject * amy_capi_py_get_output_buffer(PyObject *self, PyObject *args) {
    (void)self;
    (void)args;
    uint8_t buf[1024];
    int n = amy_get_output_buffer((int16_t *)buf);
    if (n == 0) Py_RETURN_NONE;
    return PyBytes_FromStringAndSize((const char *)buf, n);
}

static PyObject * amy_capi_py_get_input_buffer(PyObject *self, PyObject *args) {
    (void)self;
    (void)args;
    uint8_t buf[1024];
    int n = amy_get_input_buffer((int16_t *)buf);
    if (n == 0) Py_RETURN_NONE;
    return PyBytes_FromStringAndSize((const char *)buf, n);
}
