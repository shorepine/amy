// GENERATED by scripts/gen_amy_c_api.py -- do not edit; edit the table there
static mp_obj_t amy_capi_mp_send_wire(size_t n_args, const mp_obj_t *args) {
    (void)n_args;
    char *message = (char *)mp_obj_str_get_str(args[0]);
    amy_add_message(message);
    return mp_const_none;
}
static MP_DEFINE_CONST_FUN_OBJ_VAR_BETWEEN(amy_capi_mp_send_wire_obj, 1, 1, amy_capi_mp_send_wire);

static mp_obj_t amy_capi_mp_ticks_ms(size_t n_args, const mp_obj_t *args) {
    (void)n_args; (void)args;
    return mp_obj_new_int_from_uint(amy_sysclock());
}
static MP_DEFINE_CONST_FUN_OBJ_VAR_BETWEEN(amy_capi_mp_ticks_ms_obj, 0, 0, amy_capi_mp_ticks_ms);

static mp_obj_t amy_capi_mp_reset_sysclock(size_t n_args, const mp_obj_t *args) {
    (void)n_args; (void)args;
    amy_reset_sysclock();
    return mp_const_none;
}
static MP_DEFINE_CONST_FUN_OBJ_VAR_BETWEEN(amy_capi_mp_reset_sysclock_obj, 0, 0, amy_capi_mp_reset_sysclock);

static mp_obj_t amy_capi_mp_render_load(size_t n_args, const mp_obj_t *args) {
    (void)n_args; (void)args;
    return mp_obj_new_float(amy_get_render_load());
}
static MP_DEFINE_CONST_FUN_OBJ_VAR_BETWEEN(amy_capi_mp_render_load_obj, 0, 0, amy_capi_mp_render_load);

static mp_obj_t amy_capi_mp_set_render_load_threshold(size_t n_args, const mp_obj_t *args) {
    (void)n_args;
    float threshold = (float)mp_obj_get_float(args[0]);
    amy_set_render_load_threshold(threshold);
    return mp_const_none;
}
static MP_DEFINE_CONST_FUN_OBJ_VAR_BETWEEN(amy_capi_mp_set_render_load_threshold_obj, 1, 1, amy_capi_mp_set_render_load_threshold);

static mp_obj_t amy_capi_mp_bleep(size_t n_args, const mp_obj_t *args) {
    uint32_t start = (n_args > 0) ? (uint32_t)mp_obj_get_int(args[0]) : (uint32_t)0;
    amy_bleep(start);
    return mp_const_none;
}
static MP_DEFINE_CONST_FUN_OBJ_VAR_BETWEEN(amy_capi_mp_bleep_obj, 0, 1, amy_capi_mp_bleep);

static mp_obj_t amy_capi_mp_sequencer_ticks(size_t n_args, const mp_obj_t *args) {
    (void)n_args; (void)args;
    return mp_obj_new_int_from_uint(sequencer_ticks());
}
static MP_DEFINE_CONST_FUN_OBJ_VAR_BETWEEN(amy_capi_mp_sequencer_ticks_obj, 0, 0, amy_capi_mp_sequencer_ticks);

static mp_obj_t amy_capi_mp_process_single_midi_byte(size_t n_args, const mp_obj_t *args) {
    uint8_t byte = (uint8_t)mp_obj_get_int(args[0]);
    uint8_t from_web_or_usb = (n_args > 1) ? (uint8_t)mp_obj_get_int(args[1]) : (uint8_t)1;
    amy_process_single_midi_byte(byte, from_web_or_usb);
    return mp_const_none;
}
static MP_DEFINE_CONST_FUN_OBJ_VAR_BETWEEN(amy_capi_mp_process_single_midi_byte_obj, 1, 2, amy_capi_mp_process_single_midi_byte);

static mp_obj_t amy_capi_mp_set_cv_from_osc(size_t n_args, const mp_obj_t *args) {
    (void)n_args;
    int32_t cv_channel = (int32_t)mp_obj_get_int(args[0]);
    int32_t osc = (int32_t)mp_obj_get_int(args[1]);
    set_cv_from_osc(cv_channel, osc);
    return mp_const_none;
}
static MP_DEFINE_CONST_FUN_OBJ_VAR_BETWEEN(amy_capi_mp_set_cv_from_osc_obj, 2, 2, amy_capi_mp_set_cv_from_osc);

static mp_obj_t amy_capi_mp_get_synth_commands(size_t n_args, const mp_obj_t *args) {
    char s[MAX_MESSAGE_LEN];
    void *state = NULL;
    uint8_t synth = (uint8_t)mp_obj_get_int(args[0]);
    bool include_fx = (n_args > 1) ? mp_obj_is_true(args[1]) : true;
    mp_obj_t list = mp_obj_new_list(0, NULL);
    do {
        state = yield_synth_commands(synth, s, MAX_MESSAGE_LEN, include_fx, state);
        int slen = strlen(s);
        if (slen)
            mp_obj_list_append(list, mp_obj_new_str(s, slen));
    } while (state != NULL);
    return list;
}
static MP_DEFINE_CONST_FUN_OBJ_VAR_BETWEEN(amy_capi_mp_get_synth_commands_obj, 1, 2, amy_capi_mp_get_synth_commands);

static mp_obj_t amy_capi_mp_dump_state(size_t n_args, const mp_obj_t *args) {
    (void)n_args; (void)args;
    int len = 0;
    char *dump = amy_dump_state_to_string(&len);
    if (dump == NULL) mp_raise_msg(&mp_type_MemoryError, NULL);
    mp_obj_t result = mp_obj_new_str(dump, len);
    free(dump);
    return result;
}
static MP_DEFINE_CONST_FUN_OBJ_VAR_BETWEEN(amy_capi_mp_dump_state_obj, 0, 0, amy_capi_mp_dump_state);

static mp_obj_t amy_capi_mp_get_output_buffer(size_t n_args, const mp_obj_t *args) {
    (void)n_args; (void)args;
    uint8_t buf[1024];
    int n = amy_get_output_buffer((int16_t *)buf);
    if (n == 0) return mp_const_none;
    return mp_obj_new_bytes(buf, n);
}
static MP_DEFINE_CONST_FUN_OBJ_VAR_BETWEEN(amy_capi_mp_get_output_buffer_obj, 0, 0, amy_capi_mp_get_output_buffer);

static mp_obj_t amy_capi_mp_get_input_buffer(size_t n_args, const mp_obj_t *args) {
    (void)n_args; (void)args;
    uint8_t buf[1024];
    int n = amy_get_input_buffer((int16_t *)buf);
    if (n == 0) return mp_const_none;
    return mp_obj_new_bytes(buf, n);
}
static MP_DEFINE_CONST_FUN_OBJ_VAR_BETWEEN(amy_capi_mp_get_input_buffer_obj, 0, 0, amy_capi_mp_get_input_buffer);
