// GENERATED by scripts/gen_amy_c_api.py -- do not edit; edit the table there
{ MP_ROM_QSTR(MP_QSTR_amy_send), MP_ROM_PTR(&amy_capi_mp_send_wire_obj) },
{ MP_ROM_QSTR(MP_QSTR_amy_ticks_ms), MP_ROM_PTR(&amy_capi_mp_ticks_ms_obj) },
{ MP_ROM_QSTR(MP_QSTR_amy_reset_sysclock), MP_ROM_PTR(&amy_capi_mp_reset_sysclock_obj) },
{ MP_ROM_QSTR(MP_QSTR_amy_render_load), MP_ROM_PTR(&amy_capi_mp_render_load_obj) },
{ MP_ROM_QSTR(MP_QSTR_amy_set_render_load_threshold), MP_ROM_PTR(&amy_capi_mp_set_render_load_threshold_obj) },
{ MP_ROM_QSTR(MP_QSTR_amy_bleep), MP_ROM_PTR(&amy_capi_mp_bleep_obj) },
{ MP_ROM_QSTR(MP_QSTR_amy_sequencer_ticks), MP_ROM_PTR(&amy_capi_mp_sequencer_ticks_obj) },
{ MP_ROM_QSTR(MP_QSTR_amy_process_single_midi_byte), MP_ROM_PTR(&amy_capi_mp_process_single_midi_byte_obj) },
{ MP_ROM_QSTR(MP_QSTR_amy_set_cv_from_osc), MP_ROM_PTR(&amy_capi_mp_set_cv_from_osc_obj) },
{ MP_ROM_QSTR(MP_QSTR_amy_get_synth_commands), MP_ROM_PTR(&amy_capi_mp_get_synth_commands_obj) },
{ MP_ROM_QSTR(MP_QSTR_amy_dump_state), MP_ROM_PTR(&amy_capi_mp_dump_state_obj) },
{ MP_ROM_QSTR(MP_QSTR_amy_get_output_buffer), MP_ROM_PTR(&amy_capi_mp_get_output_buffer_obj) },
{ MP_ROM_QSTR(MP_QSTR_amy_get_input_buffer), MP_ROM_PTR(&amy_capi_mp_get_input_buffer_obj) },
