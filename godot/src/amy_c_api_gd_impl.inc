// GENERATED by scripts/gen_amy_c_api.py -- do not edit; edit the table there
void AmySynth::reset_sysclock() { ::amy_reset_sysclock(); }
double AmySynth::render_load() { return (double)::amy_get_render_load(); }
void AmySynth::set_render_load_threshold(double threshold) { ::amy_set_render_load_threshold((float)threshold); }
void AmySynth::bleep(int64_t start) { ::amy_bleep((uint32_t)start); }
int64_t AmySynth::sequencer_ticks() { return (int64_t)::sequencer_ticks(); }
String AmySynth::dump_state() {
	int len = 0;
	char *dump = ::amy_dump_state_to_string(&len);
	if (dump == NULL) return String();
	String result = String::utf8(dump, len);
	::free(dump);
	return result;
}
